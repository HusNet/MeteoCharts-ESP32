#include <Adafruit_BME280.h>
#include <SSD1306.h>
#include <WiFi.h>
#include <HTTPClient.h>
#include "conf.h"

#define LED_BLUE 17
#define SDA 21
#define SCL 22
#define BME280_BUS 0x76
#define SSD1306_BUS 0x3C
#define SCREEN_WIDTH 128 
#define SCREEN_HEIGHT 64
#define OLED_RESET -1
const int BATTERY_PIN = A0;

String MAC_ADDRESS = "";




// WEB SERVER Data
const String HTTP_METHOD = "POST";
const String PATH_NAME   = "/api/devices/sensors";
String token = "";
HTTPClient http;

float temp;
float hum;
float hpa;

WiFiClientSecure client;
Adafruit_BME280 bme; // I2C
SSD1306 screen(SSD1306_BUS, SDA, SCL);

const unsigned char PROGMEM error[] = {
  0x00, 0x00, 0x00, 0x00, 0x00, 0x00, 0x00, 0x00, 0x60, 0x00, 0x40, 0x01, 
  0xF0, 0x00, 0xE0, 0x01, 0xE0, 0x01, 0xF0, 0x00, 0xC0, 0x03, 0x78, 0x00, 
  0x80, 0x07, 0x78, 0x00, 0x80, 0x07, 0x3C, 0x00, 0x00, 0x0F, 0x1E, 0x00, 
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  0x20, 0x00, 0x00, 0x00, 0x00, 0x00, 0x00, 0x00, 0x00, 0x00, 0x00, 0x00, 
};
const unsigned char PROGMEM loading_1[] = {
  0x00, 0x00, 0x00, 0x00, 0x00, 0x00, 0x00, 0x00, 0x00, 0x00, 0x00, 0x00, 
  0x00, 0x00, 0x00, 0x00, 0x00, 0x00, 0x00, 0x00, 0x00, 0x00, 0x00, 0x00, 
  0x00, 0x00, 0x00, 0x00, 0x00, 0x00, 0x00, 0x00, 0x00, 0x00, 0x00, 0x00, 
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  0x00, 0x00, 0x00, 0x00, 0x00, 0x00, 0x00, 0x00, 0x00, 0x00, 0x00, 0x00, 
};
const unsigned char PROGMEM loading_2[] = {
  0x00, 0x00, 0x00, 0x00, 0x00, 0x00, 0x00, 0x00, 0x00, 0x00, 0x00, 0x00, 
  0x00, 0x00, 0x00, 0x00, 0x00, 0x00, 0x00, 0x00, 0x00, 0x00, 0x00, 0x00, 
  0x00, 0x00, 0x00, 0x00, 0x00, 0x00, 0x00, 0x00, 0x00, 0x00, 0x00, 0x00, 
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  0x00, 0x00, 0x00, 0x00, 0x00, 0x00, 0x00, 0x00, 0x00, 0x00, 0x00, 0x00, 
};
const unsigned char PROGMEM loading_3[] = {
  0x00, 0x00, 0x00, 0x00, 0x00, 0x00, 0x00, 0x00, 0x00, 0x00, 0x00, 0x00, 
  0x00, 0x78, 0x00, 0x00, 0x00, 0x3F, 0x00, 0x00, 0x80, 0x1F, 0x00, 0x00, 
  0xC0, 0x03, 0x00, 0x00, 0xE0, 0x00, 0x00, 0x00, 0x60, 0x00, 0x00, 0x00, 
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  0x00, 0x00, 0x00, 0x00, 0x00, 0x00, 0x00, 0x00, 0x00, 0x00, 0x00, 0x00, 
};
const unsigned char PROGMEM loading[] = {
// 'loading', 30x30px
  0x00, 0x00, 0x00, 0x00, 0x00, 0x00, 0x00, 0x00, 0x00, 0x00, 0x00, 0x00, 
  0x00, 0xF8, 0x03, 0x00, 0x00, 0xFE, 0x0F, 0x00, 0x00, 0x8F, 0x3E, 0x00, 
  0xC0, 0x03, 0x78, 0x00, 0xE0, 0x00, 0xF0, 0x00, 0x70, 0x00, 0xC0, 0x00, 
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  0x00, 0x00, 0x00, 0x00, 0x00, 0x00, 0x00, 0x00, 0x00, 0x00, 0x00, 0x00, 
};

void setup() {
  
  pinMode(LED_BLUE, OUTPUT);
  ledTrigger(LED_BLUE, false);
  
  Serial.begin(115200);
  while(!Serial);    // time to get serial running
  Serial.println("Ready...");

  if (!bme.begin(BME280_BUS)) {
    Serial.println("Could not find a valid BMP280 sensor, check wiring!");
    ledTrigger(LED_BLUE, true);
    ESP.restart();
  }
  else {
    Serial.println("BMP280 connected!");
  }
  
  setupWifi();

  screen.init();

  screen.setFont(ArialMT_Plain_16);

}

void loop() {

  drawLoading();

  bool bmp_success = getMeteoChartsData();

  delay(500);

  if(bmp_success) {
    ledTrigger(LED_BLUE, false);
    
    screen.clear();
    char str [80];
    sprintf(str, "%.1f C°", temp);
    screen.drawString(0,0, str);
    sprintf(str, "%.1f %%", hum);
    screen.drawString(0,20, str);
    sprintf(str, "%d hPa", hpa);
    screen.drawString(0,40, str);
    screen.display();
  }
  else {
    ledTrigger(LED_BLUE, true);
    screen.drawXbm(screen.getWidth()-37, 5, 30, 30, error);
    screen.display();
  }

  webRequest();

  esp_deep_sleep(60e6);
}

void drawLoading(){
  screen.drawXbm(screen.getWidth()-37, 5, 30, 30, loading_1);
  screen.display();
  delay(250);
  screen.drawXbm(screen.getWidth()-37, 5, 30, 30, loading_2);
  screen.display();
  delay(250);
  screen.drawXbm(screen.getWidth()-37, 5, 30, 30, loading_3);
  screen.display();
  delay(250);
  screen.drawXbm(screen.getWidth()-37, 5, 30, 30, loading);
  screen.display();
}

bool getMeteoChartsData() {
  
  temp = bme.readTemperature();
  hum = bme.readHumidity();
  hpa = bme.readPressure()/100;
 
  if (isnan(hum) || isnan(temp) || isnan(hpa)) {
      Serial.println("Failed to read data from sensor!");
      return false;
  }
  Serial.print(temp);
  Serial.print("°C");
  Serial.print(" - ");
  Serial.print(hum);
  Serial.print("%");
  Serial.print(" - ");
  Serial.print(hpa);
  Serial.println(" hPa");

  return true;
}

void webRequest() {

  String queryString = "{\"mac\":\"" + MAC_ADDRESS + "\",\"battery\":\"" + String(batteryPercent(), 2) + "\",\"temperature\":\"" + temp + "\",\"humidity\":" + hum + ",\"pressure\":\"" + hpa + "\",\"token\":\"" + token + "\"}";

  Serial.println("LOGS : " + queryString);

  http.begin(client, SERVER_NAME, HTTP_PORT, PATH_NAME, true);
  http.addHeader("Content-Type", "application/json");
  int httpResponseCode = http.POST(queryString);

  String payload = "null";
  if (httpResponseCode > 0) {
    //Get the request response payload
    payload = http.getString();
  }
  else {
    Serial.print("FATL : Server unreachable - Code : ");
    Serial.println(httpResponseCode);
    return;
  }

  // Free resources
  http.end();

  //Payload management

  JSONVar json_payload = JSON.parse(payload);
  if (JSON.typeof(json_payload) == "undefined") {
    Serial.print("WARN : Parsing input failed! -> ");
    Serial.println(payload);
    return;
  }

  int code = JSON.stringify(json_payload["code"]).toInt();
  String message = JSON.stringify(json_payload["message"]);

  String new_token = (const char*) json_payload["register_token"];


  switch(code) {
    case 0:
      Serial.println("DEBG : Ok");
      break;
    case 9:
      Serial.println("DEBG : Invalid payload ");
      // LED ERROR CODE Payload error
      // errorMacMissing();
    case 10:
      Serial.println("DEBG : Missing Mac ");
      // LED ERROR CODE MAC UNKNOWN
      // errorMacMissing();
      break; 
    case 11:  
      Serial.println("DEBG : Mac not found in DB");
      break;
    case 12:  
      Serial.println("DEBG : Wrong Token");
      break;
    case 50:
      Serial.println("DEBG : Token register - " + new_token);
      token = new_token;
      webRequest();
      break;
    default :
      Serial.print("DEBG : Unknown code - ");
      Serial.println(json_payload["code"]);
      break;
  }
  
}


void ledTrigger(int color, bool on){
  if (on)
    digitalWrite(color, LOW);
  else
    digitalWrite(color, HIGH);
}

void setupWifi() {

  Serial.print("Connecting to : ");
  Serial.println(WIFI_SSID);

  WiFi.begin(WIFI_SSID, WIFI_PASSWD);
  while (WiFi.status() != WL_CONNECTED) {
    delay(500);
    Serial.print("-");
    delay(500);
  }  

  MAC_ADDRESS = WiFi.macAddress();
  Serial.println("INFO : Mac Address : " + MAC_ADDRESS);

  // Print local IP address 
  Serial.println("");
  Serial.println("WiFi connected.");
  Serial.print("IP address : ");
  Serial.println(WiFi.localIP());
}

float batteryPercent() {
  int value = analogRead(BATTERY_PIN);
  float voltage = value * 5.0/1023;
  float perc = map(voltage, 3.6, 4.2, 0, 100);
}
